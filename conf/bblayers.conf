## conf/bblayers.conf
```bitbake
# POKY_BBLAYERS_CONF_VERSION is increased each time build/conf/bblayers.conf
# changes incompatibly and is used to track the version of this file when it was
# generated. This is meant to track the version of the build system itself, not
# the version of the metadata.
POKY_BBLAYERS_CONF_VERSION = "2"

BBPATH = "${TOPDIR}"
BBFILES ?= ""

BBLAYERS ?= " \
  ##OEROOT##/meta \
  ##OEROOT##/meta-poky \
  ##OEROOT##/meta-yocto-bsp \
  ##PROJECTROOT##/meta-bbdemo \
  "
```

## conf/local.conf
```bitbake
#
# This file is your local configuration file and all settings put into this file
# will take precedence over other settings. This file will not be tracked by git.
#

# Machine Selection
# You need to select a specific machine to target the build with.
MACHINE ??= "qemux86-64"

# Where to place output files
TMPDIR = "${TOPDIR}/tmp"

# Where to save source code
DL_DIR = "${TOPDIR}/../downloads"

# Where to save shared state
SSTATE_DIR = "${TOPDIR}/../sstate-cache"

# Package Management
PACKAGE_CLASSES ?= "package_rpm"

# SDK target architecture
SDKMACHINE = "x86_64"

# Additional image features
# This enables SSH server and other useful features
EXTRA_IMAGE_FEATURES ?= "debug-tweaks"

# User/Group IDs
EXTRA_USERS_PARAMS = "useradd -p '' demo;"

# Disk Space Monitoring during the build
BB_DISKMON_DIRS ??= "\
    STOPTASKS,${TMPDIR},1G,100M \
    STOPTASKS,${DL_DIR},1G,100M \
    STOPTASKS,${SSTATE_DIR},1G,100M \
    STOPTASKS,${TOPDIR},1G,100M \
    HALT,${TMPDIR},100M,1K \
    HALT,${DL_DIR},100M,1K \
    HALT,${SSTATE_DIR},100M,1K \
    HALT,${TOPDIR},100M,1K"

# Shared-state files from other locations
# As an example of how to pre-populate SSTATE_DIR, you can fetch
# a tarball of sstate files from a server and extract it into SSTATE_DIR.
# See the Yocto Project documentation for details.

# CONF_VERSION is increased each time build/conf/ changes incompatibly and is used to
# track the version of this file when it was generated. This is meant to track
# the version of the build system itself, not the version of the metadata.
CONF_VERSION = "2"
```

## meta-bbdemo/conf/layer.conf
```bitbake
# We have a conf and classes directory, add to BBPATH
BBPATH .= ":${LAYERDIR}"

# We have a recipes-* directories, add to BBFILES
BBFILES += "${LAYERDIR}/recipes-*/*/*.bb \
            ${LAYERDIR}/recipes-*/*/*.bbappend"

BBFILE_COLLECTIONS += "bbdemo"
BBFILE_PATTERN_bbdemo = "^${LAYERDIR}/"
BBFILE_PRIORITY_bbdemo = "6"

LAYERDEPENDS_bbdemo = "core"
LAYERSERIES_COMPAT_bbdemo = "scarthgap"
```
